## boards/arm/nrf52_ruuvi/Kconfig.defconfig
```kconfig
# nRF52 PCA10040 board configuration

# Copyright (c) 2016 Nordic Semiconductor ASA
# SPDX-License-Identifier: Apache-2.0

if BOARD_NRF52_RUUVI

config BOARD
	default "nrf52_ruuvi"

config ADC_0
	default y
	depends on ADC

config PWM_0
	default y
	depends on PWM

config SPI_0
	default y


config BT_CTLR
	default BT

endif # BOARD_NRF52_RUUVI
```

## boards/arm/ruuvi_ruuvitag/ruuvi_ruuvitag_defconfig
```kconfig
# Copyright (c) 2020 Ruuvi Innovations Ltd (Oy)
# SPDX-License-Identifier: Apache-2.0

CONFIG_SOC_SERIES_NRF52X=y
CONFIG_SOC_NRF52832_QFAA=y
CONFIG_BOARD_RUUVI_RUUVITAG=y

# Enable hardware stack protection
CONFIG_HW_STACK_PROTECTION=y

# Enable MPU
CONFIG_ARM_MPU=y

# Enable GPIO
CONFIG_GPIO=y

# additional board options
CONFIG_GPIO_AS_PINRESET=n
```

## build_mcuboot/Kconfig/Kconfig.modules
```kconfig
menu "nrf (/home/anthony/dev/Zephyr/ncs_1_7_0/nrf)"
osource "/home/anthony/dev/Zephyr/ncs_1_7_0/nrf/Kconfig.nrf"
config ZEPHYR_NRF_MODULE
	bool
	default y
endmenu
menu "mcuboot (/home/anthony/dev/Zephyr/ncs_1_7_0/bootloader/mcuboot)"
osource "$(ZEPHYR_MCUBOOT_KCONFIG)"
config ZEPHYR_MCUBOOT_MODULE
	bool
	default y
endmenu
menu "trusted-firmware-m (/home/anthony/dev/Zephyr/ncs_1_7_0/modules/tee/tfm)"
osource "$(ZEPHYR_TRUSTED_FIRMWARE_M_KCONFIG)"
config ZEPHYR_TRUSTED_FIRMWARE_M_MODULE
	bool
	default y
endmenu
menu "cjson (/home/anthony/dev/Zephyr/ncs_1_7_0/modules/lib/cjson)"
osource "$(ZEPHYR_CJSON_KCONFIG)"
config ZEPHYR_CJSON_MODULE
	bool
	default y
endmenu
menu "pelion-dm (/home/anthony/dev/Zephyr/ncs_1_7_0/modules/lib/pelion-dm)"
osource "/home/anthony/dev/Zephyr/ncs_1_7_0/modules/lib/pelion-dm/zephyr/Kconfig"
config ZEPHYR_PELION_DM_MODULE
	bool
	default y
endmenu
menu "cddl-gen (/home/anthony/dev/Zephyr/ncs_1_7_0/modules/lib/cddl-gen)"
osource "$(ZEPHYR_CDDL_GEN_KCONFIG)"
config ZEPHYR_CDDL_GEN_MODULE
	bool
	default y
endmenu
menu "memfault-firmware-sdk (/home/anthony/dev/Zephyr/ncs_1_7_0/modules/lib/memfault-firmware-sdk)"
osource "/home/anthony/dev/Zephyr/ncs_1_7_0/modules/lib/memfault-firmware-sdk/ports/zephyr/Kconfig"
config ZEPHYR_MEMFAULT_FIRMWARE_SDK_MODULE
	bool
	default y
endmenu
menu "CANopenNode (/home/anthony/dev/Zephyr/ncs_1_7_0/modules/lib/canopennode)"
osource "$(ZEPHYR_CANOPENNODE_KCONFIG)"
config ZEPHYR_CANOPENNODE_MODULE
	bool
	default y
endmenu
menu "hal_nordic (/home/anthony/dev/Zephyr/ncs_1_7_0/modules/hal/nordic)"
osource "$(ZEPHYR_HAL_NORDIC_KCONFIG)"
config ZEPHYR_HAL_NORDIC_MODULE
	bool
	default y
endmenu
menu "loramac-node (/home/anthony/dev/Zephyr/ncs_1_7_0/modules/lib/loramac-node)"
osource "$(ZEPHYR_LORAMAC_NODE_KCONFIG)"
config ZEPHYR_LORAMAC_NODE_MODULE
	bool
	default y
endmenu
menu "lz4 (/home/anthony/dev/Zephyr/ncs_1_7_0/modules/lib/lz4)"
osource "$(ZEPHYR_LZ4_KCONFIG)"
config ZEPHYR_LZ4_MODULE
	bool
	default y
endmenu
menu "mbedtls (/home/anthony/dev/Zephyr/ncs_1_7_0/modules/crypto/mbedtls)"
osource "$(ZEPHYR_MBEDTLS_KCONFIG)"
config ZEPHYR_MBEDTLS_MODULE
	bool
	default y
endmenu
menu "nanopb (/home/anthony/dev/Zephyr/ncs_1_7_0/modules/lib/nanopb)"
osource "$(ZEPHYR_NANOPB_KCONFIG)"
config ZEPHYR_NANOPB_MODULE
	bool
	default y
endmenu
menu "TraceRecorder (/home/anthony/dev/Zephyr/ncs_1_7_0/modules/debug/TraceRecorder)"
osource "/home/anthony/dev/Zephyr/ncs_1_7_0/modules/debug/TraceRecorder/kernelports/Zephyr/Kconfig"
config ZEPHYR_TRACERECORDER_MODULE
	bool
	default y
endmenu
menu "nrfxlib (/home/anthony/dev/Zephyr/ncs_1_7_0/nrfxlib)"
osource "/home/anthony/dev/Zephyr/ncs_1_7_0/nrfxlib/Kconfig.nrfxlib"
config ZEPHYR_NRFXLIB_MODULE
	bool
	default y
endmenu
menu "connectedhomeip (/home/anthony/dev/Zephyr/ncs_1_7_0/modules/lib/matter)"
osource "/home/anthony/dev/Zephyr/ncs_1_7_0/modules/lib/matter/config/nrfconnect/chip-module/Kconfig"
config ZEPHYR_CONNECTEDHOMEIP_MODULE
	bool
	default y
endmenu
```

## build_mcuboot/Kconfig/Kconfig.shield.defconfig
```kconfig
osource "/home/anthony/dev/Zephyr/ncs_1_7_0/nrf/boards/shields/*/Kconfig.defconfig"
```

## drivers/lis2dh12/zephyr/Kconfig
```kconfig
# LIS2DH12 Three Axis Accelerometer configuration options

menuconfig LIS2DH12
	bool "LIS2DH12 Three Axis Accelerometer"
	depends on SPI
	select HAS_STMEMSC
	select USE_STDC_LIS2DH12
	help
	  Enable SPI-based driver for LIS2DH12 triaxial accelerometer sensors.

if LIS2DH12

config LIS2DH12_INIT_PRIORITY
	int "Sensor Init Priority"
	range 0 100
	default 90

config LIS2DH12_LOG_LEVEL
	int "Log Level"
	range 0 6
	default 3

choice
	prompt "Acceleration measurement range"
	default LIS2DH12_ACCEL_RANGE_2G
	help
	  Initial measurement full scale range for acceleration values.

config LIS2DH12_ACCEL_RANGE_2G
	bool "+/-2g"

config LIS2DH12_ACCEL_RANGE_4G
	bool "+/-4g"

config LIS2DH12_ACCEL_RANGE_8G
	bool "+/-8g"

config LIS2DH12_ACCEL_RANGE_16G
	bool "+/-16g"

endchoice

choice
	prompt "Operation mode"
	default LIS2DH12_OPER_MODE_NORMAL
	help
	  Choose between high resolution, normal or low power operation
	  mode for chip at init.

config LIS2DH12_OPER_MODE_HIGH_RES
	bool "high resolution (12 bit)"

config LIS2DH12_OPER_MODE_NORMAL
	bool "normal (10 bit)"

config LIS2DH12_OPER_MODE_LOW_POWER
	bool "low power (8 bit)"

endchoice

choice
	prompt "Output data rate frequency"
	default LIS2DH12_ODR_1
	help
	  Initial data rate frequency of acceleration data at initialization.
	  Supported values:
	  1Hz, 10Hz, 25Hz, 50Hz, 100Hz, 200Hz, 400Hz in all power modes
	  1620Hz, 5376Hz in low power mode only
	  1344Hz in normal power mode

config LIS2DH12_ODR_1
	bool "1Hz"

config LIS2DH12_ODR_10
	bool "10Hz"

config LIS2DH12_ODR_25
	bool "25Hz"

config LIS2DH12_ODR_50
	bool "50Hz"

config LIS2DH12_ODR_100
	bool "100Hz"

config LIS2DH12_ODR_200
	bool "200Hz"

config LIS2DH12_ODR_400
	bool "400Hz"

endchoice

config LIS2DH12_FIFO_ENABLED
	bool "Enable FiFo"
	default False

if LIS2DH12_FIFO_ENABLED

choice
	prompt "FiFo Mode"
	default LIS2DH12_BYPASS_MODE
	help
	  Choose FiFo mode.

config LIS2DH12_BYPASS_MODE
	bool "FiFO Bypassed"

config LIS2DH12_FIFO_MODE
	bool "Normal FiFo mode."

config LIS2DH12_DYNAMIC_STREAM_MODE
	bool "Dynamic Stream Mode."

config LIS2DH12_STREAM_TO_FIFO_MODE
	bool "Stream to FiFo Mode."

endchoice

config LIS2DH_FIFO_WM
	int "FiFO Watermark Size"
	range 0 31
	default 31

endif

config LIS2DH12_TEMP_EN
	bool "Temperature Enabled"
	default False

endif # LIS2DH12
```

## drivers/tmp117/zephyr/Kconfig
```kconfig
# TMP117 temperature sensor configuration options

menuconfig TMP117
	bool "TMP117 Temperature Sensors"
	depends on I2C
	help
	  Enable I2C driver for TMP117 temperature sensor.

if TMP117

config TMP117_INIT_PRIORITY
	int "Sensor Init Priority"
	range 0 100
	default 90

config TMP117_LOG_LEVEL
	int "Log Level"
	range 0 6
	default 3

choice
	prompt "TMP117 Oversampling"
	default TMP117_OS_1

config TMP117_OS_1
	bool "Oversampling 1x"

config TMP117_OS_8
	bool "Oversampling 8x"

config TMP117_OS_32
	bool "Oversampling 32x"

config TMP117_OS_64
	bool "Oversampling 64x"

endchoice

choice
	prompt "TMP117 Samplerate"
	default TMP117_16_MS

config TMP117_16_MS
	bool "Samplerate of 16ms"

config TMP117_125_MS
	bool "Samplerate of 125ms"

config TMP117_250_MS
	bool "Samplerate of 250ms"

config TMP117_500_MS
	bool "Samplerate of 500ms"

config TMP117_1000_MS
	bool "Samplerate of 1s"

config TMP117_4000_MS
	bool "Samplerate of 4s"

config TMP117_8000_MS
	bool "Samplerate of 8s"

config TMP117_16000_MS
	bool "Samplerate of 16s"

endchoice

choice
	prompt "TMP117 Mode"
	default TMP117_MODE_SINGLE

config TMP117_MODE_SINGLE
	bool "Single Mode"

config TMP117_MODE_CONTINOUS
	bool "Continous Mode"

config TMP117_MODE_SLEEP
	bool "Sleep Mode"

endchoice


endif #TMP117
```
